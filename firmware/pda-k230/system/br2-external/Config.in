## firmware/pda-k230/system/br2-external/Config.in
```kconfig
menu "Athena PDA (T-Display K230)"

source "$BR2_EXTERNAL_ATHENA_PDA_PATH/package/athena-pda-system/Config.in"
source "$BR2_EXTERNAL_ATHENA_PDA_PATH/package/athena-tailscale-bin/Config.in"
source "$BR2_EXTERNAL_ATHENA_PDA_PATH/package/athena-pda-lvgl-src/Config.in"
source "$BR2_EXTERNAL_ATHENA_PDA_PATH/package/athena-pda-ui/Config.in"
source "$BR2_EXTERNAL_ATHENA_PDA_PATH/package/athena-pda-syncd/Config.in"
source "$BR2_EXTERNAL_ATHENA_PDA_PATH/package/athena-vision/Config.in"
source "$BR2_EXTERNAL_ATHENA_PDA_PATH/package/athena-vision-kmodels/Config.in"

endmenu
```

## firmware/pda-k230/system/br2-external/package/athena-pda-lvgl-src/Config.in
```kconfig
config BR2_PACKAGE_ATHENA_PDA_LVGL_SRC
	bool
	help
	  The LVGL source tree (pinned commit) the athena-pda UI builds
	  with its own lv_conf.h. Only downloaded and extracted; nothing
	  is installed. Selected by athena-pda-ui.
```

## firmware/pda-k230/system/br2-external/package/athena-pda-syncd/Config.in
```kconfig
config BR2_PACKAGE_ATHENA_PDA_SYNCD
	bool "athena-pda-syncd"
	depends on BR2_PACKAGE_PYTHON3
	depends on BR2_PACKAGE_ATHENA_PDA_SYSTEM
	select BR2_PACKAGE_PYTHON3_SSL
	select BR2_PACKAGE_PYTHON3_ZLIB
	help
	  athena-pda-syncd, the PDA's relay (firmware/pda-k230/syncd):
	  pairing with the hub, the hub client and PdaSync over
	  glance.sock, with the BLE-free modules of the PC relay
	  (firmware/recorder/tools/athena_relay). Standard library only.
	  Started at boot by S93athena-pda-syncd.

comment "athena-pda-syncd needs python3"
	depends on !BR2_PACKAGE_PYTHON3
```

## firmware/pda-k230/system/br2-external/package/athena-pda-system/Config.in
```kconfig
config BR2_PACKAGE_ATHENA_PDA_SYSTEM
	bool "athena-pda-system"
	depends on BR2_PACKAGE_BUSYBOX # start-stop-daemon, logger, udhcpc
	depends on BR2_PACKAGE_PYTHON3 # athena-wifi, athena-tailnet
	select BR2_PACKAGE_WPA_SUPPLICANT
	help
	  The Athena PDA's system pieces: the athena-pda user, the
	  settings file /etc/default/athena-pda, the supervisor that
	  restarts the PDA's programs, Wi-Fi at boot (S42athena-wifi,
	  athena-wifi) and the athena-board, athena-tailnet and
	  athena-boot-ui helpers.

comment "athena-pda-system needs busybox and python3"
	depends on !BR2_PACKAGE_BUSYBOX || !BR2_PACKAGE_PYTHON3
```

## firmware/pda-k230/system/br2-external/package/athena-pda-ui/Config.in
```kconfig
config BR2_PACKAGE_ATHENA_PDA_UI
	bool "athena-pda-ui"
	depends on BR2_TOOLCHAIN_HAS_THREADS # libdrm
	depends on BR2_PACKAGE_ATHENA_PDA_SYSTEM
	select BR2_PACKAGE_ATHENA_PDA_LVGL_SRC
	select BR2_PACKAGE_LIBDRM
	select BR2_PACKAGE_LIBEVDEV
	help
	  athena-pda, the PDA's screens (firmware/pda-k230/ui): LVGL 9
	  on DRM and evdev, the feed store and the outbox, the server
	  end of glance.sock and vision.sock. Started at boot by
	  S92athena-pda in place of LilyGO's launcher.

comment "athena-pda-ui needs a toolchain w/ threads"
	depends on !BR2_TOOLCHAIN_HAS_THREADS
```

## firmware/pda-k230/system/br2-external/package/athena-tailscale-bin/Config.in
```kconfig
config BR2_PACKAGE_ATHENA_TAILSCALE_BIN
	bool "athena-tailscale-bin"
	depends on BR2_riscv && BR2_ARCH_IS_64
	depends on !BR2_PACKAGE_TAILSCALE
	depends on BR2_PACKAGE_ATHENA_PDA_SYSTEM # athena-pda-common.sh
	help
	  Tailscale's static riscv64 build (tailscale and tailscaled,
	  pinned, checked against its sha256), started at boot by
	  S45tailscaled with its state in /var/lib/tailscale.

	  Buildroot's own tailscale package builds an older version
	  from source with Go; this one installs the official binaries.

	  https://pkgs.tailscale.com/stable/

comment "athena-tailscale-bin conflicts with the tailscale package"
	depends on BR2_PACKAGE_TAILSCALE
```

## firmware/pda-k230/system/br2-external/package/athena-vision-kmodels/Config.in
```kconfig
config BR2_PACKAGE_ATHENA_VISION_KMODELS
	bool "athena-vision-kmodels"
	help
	  The two kmodels athena-vision runs on the KPU: hand_det.kmodel
	  (palm detection) and handkp_det.kmodel (21 hand keypoints),
	  taken from Canaan's ai_demo model archive (the K230 SDK's
	  package/ai_demo/common) and installed to
	  /usr/share/athena-vision/models.
```

## firmware/pda-k230/system/br2-external/package/athena-vision/Config.in
```kconfig
config BR2_PACKAGE_ATHENA_VISION
	bool "athena-vision"
	depends on BR2_INSTALL_LIBSTDCPP
	depends on BR2_USE_WCHAR # zxing-cpp
	depends on BR2_TOOLCHAIN_HAS_THREADS # zxing-cpp
	depends on !BR2_STATIC_LIBS # zxing-cpp
	depends on BR2_PACKAGE_ATHENA_PDA_SYSTEM
	select BR2_PACKAGE_LIBNNCASE
	select BR2_PACKAGE_LIBMMZ
	select BR2_PACKAGE_VVCAM # the ISP that serves the GC2093 as V4L2, libv4l2-drm
	select BR2_PACKAGE_DISPLAY # libdisplay (pkg-config display)
	select BR2_PACKAGE_LIBDRM
	select BR2_PACKAGE_GSL_LITE # nncase headers
	select BR2_PACKAGE_ZXING_CPP # QR codes (VISION_QR=zxing)
	select BR2_PACKAGE_ATHENA_VISION_KMODELS
	help
	  athena-vision, the PDA's camera AI (firmware/pda-k230/vision):
	  hand detection and keypoints on the K230's KPU (nncase), hand
	  gestures, presence and QR codes as events on vision.sock.
	  Frames never leave the process. Started at boot by
	  S94athena-vision; the camera stays off until the UI asks.

comment "athena-vision needs a toolchain w/ C++, wchar, threads, dynamic library"
	depends on !BR2_INSTALL_LIBSTDCPP || !BR2_USE_WCHAR || \
		!BR2_TOOLCHAIN_HAS_THREADS || BR2_STATIC_LIBS
```
